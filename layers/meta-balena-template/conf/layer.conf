## layers/meta-balena-template/conf/layer.conf
```bitbake
BBPATH .= ":${LAYERDIR}"

BBFILES += "${LAYERDIR}/recipes-*/*/*.bb \
            ${LAYERDIR}/recipes-*/*/*.bbappend"

BBFILE_COLLECTIONS += "balena-template"
BBFILE_PATTERN_balena-template := "^${LAYERDIR}/"
BBFILE_PRIORITY_balena-template = "1337"

MACHINE_ESSENTIAL_EXTRA_RDEPENDS:remove = "kernel-image"

# Example masking of board recipes
BBMASK += "/meta-board-bsp/recipes-graphics/xwayland"

LAYERSERIES_COMPAT_balena-template = "honister"
SERIAL_CONSOLES:board-template = "115200;ttyS0"
```
